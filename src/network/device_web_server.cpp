#include "device_web_server.h"

#include <esp_crt_bundle.h>
#include <esp_err.h>
#include <esp_heap_caps.h>
#include <esp_http_client.h>
#include <esp_ota_ops.h>
#include <esp_system.h>
#include <freertos/FreeRTOS.h>
#include <freertos/task.h>

#include <algorithm>
#include <cctype>
#include <cstdio>
#include <cstring>
#include <ctime>
#include <functional>
#include <memory>
#include <vector>

#include "../bluetooth/manager.h"
#include "../config/build_info.h"
#include "../config/constants.h"
#include "../controllers/grind_controller.h"
#include "../hardware/hardware_manager.h"
#include "../logging/diagnostic_log.h"
#include "../logging/grind_logging.h"
#include "../storage/filesystem.h"
#include "../system/device_info.h"
#include "../system/string_utils.h"
#include "../system/timing.h"
#include "device_api.h"
#include "http_multipart.h"
#include "http_support.h"
#include "network_manager.h"
#include "ota_writer.h"
#include "provisioning_service.h"

namespace {
const char* network_state_name(NetworkState state) {
    switch (state) {
        case NetworkState::WIFI_DISABLED: return "disabled";
        case NetworkState::WIFI_NO_CREDENTIALS: return "no_credentials";
        case NetworkState::WIFI_CONNECTING: return "connecting";
        case NetworkState::WIFI_CONNECTED: return "connected";
        case NetworkState::WIFI_RETRY_WAIT: return "retry_wait";
        case NetworkState::WIFI_SETUP_REQUIRED: return "setup_required";
        case NetworkState::WIFI_SETUP_AP: return "setup_ap";
    }
    return "unknown";
}

bool history_is_busy(const GrindController* controller) {
    if (!controller) return false;
    const GrindPhase phase = controller->get_phase();
    const bool result_is_waiting = phase == GrindPhase::COMPLETED || phase == GrindPhase::TIMEOUT;
    // A completed result remains on screen until the user dismisses it, but the
    // saved session is safe to read as soon as the logger has finished writing.
    return (phase != GrindPhase::IDLE && !result_is_waiting) || grind_logger.is_logging_active();
}

constexpr uint32_t OTA_REBOOT_DELAY_MS = 1500;
constexpr uint32_t OTA_PREPARE_TIMEOUT_MS = 15000;
constexpr uint32_t OTA_READY_WINDOW_MS = 30000;
constexpr size_t OTA_MIN_INTERNAL_HEAP = 64U * 1024U;
constexpr size_t OTA_DOWNLOAD_TASK_STACK = 12U * 1024U;
constexpr uint32_t UPDATE_CHECK_INTERVAL_MS = 30U * 60U * 1000U;
constexpr uint32_t UPDATE_CHECK_RETRY_MS = 5U * 60U * 1000U;
constexpr size_t UPDATE_CHECK_TASK_STACK = 10U * 1024U;
constexpr size_t OTA_DOWNLOAD_BUFFER = 4096;
constexpr int OTA_IDLE_TIMEOUT_MS = 15000;
// GitHub Pages mirrors every published release beneath this versioned path.
// Using the mirror avoids the github.com -> release-assets.githubusercontent.com
// redirect during a memory-constrained TLS session while retaining the exact
// audited release binaries generated by the release workflow.
constexpr char GITHUB_RELEASE_MIRROR_BASE[] =
    "https://clinteastman.github.io/smart-grind-by-weight/firmware/";
constexpr char LATEST_RELEASE_MANIFEST_URL[] =
    "https://clinteastman.github.io/smart-grind-by-weight/firmware/latest.json";

OtaWriter web_firmware_update;

bool valid_release_tag(const std::string& tag) {
    if (tag.length() < 6 || tag.length() > 24 || tag[0] != 'v') return false;
    uint8_t dots = 0;
    for (size_t i = 1; i < tag.length(); ++i) {
        if (tag[i] == '.') {
            if (i == 1 || i + 1 == tag.length() || tag[i - 1] == '.') return false;
            ++dots;
        } else if (tag[i] < '0' || tag[i] > '9') {
            return false;
        }
    }
    return dots == 2;
}

bool parse_semver(const std::string& value, uint16_t& major, uint16_t& minor, uint16_t& patch) {
    const size_t offset = strings::starts_with(value, "v") ? 1U : 0U;
    const int first_dot = strings::index_of(value, '.', offset);
    const int second_dot = first_dot < 0 ? -1 : strings::index_of(value, '.', first_dot + 1);
    if (first_dot <= static_cast<int>(offset) || second_dot <= first_dot + 1 ||
        second_dot + 1 >= static_cast<int>(value.length())) {
        return false;
    }
    for (size_t i = offset; i < value.length(); ++i) {
        if (i == static_cast<size_t>(first_dot) || i == static_cast<size_t>(second_dot)) continue;
        if (!isdigit(static_cast<unsigned char>(value[i]))) return false;
    }
    const unsigned long parsed_major = strings::to_uint32(strings::slice(value, offset, first_dot));
    const unsigned long parsed_minor =
        strings::to_uint32(strings::slice(value, first_dot + 1, second_dot));
    const unsigned long parsed_patch = strings::to_uint32(value.substr(second_dot + 1));
    if (parsed_major > UINT16_MAX || parsed_minor > UINT16_MAX || parsed_patch > UINT16_MAX) {
        return false;
    }
    major = static_cast<uint16_t>(parsed_major);
    minor = static_cast<uint16_t>(parsed_minor);
    patch = static_cast<uint16_t>(parsed_patch);
    return true;
}

std::string json_string_value(const std::string& json, const char* key) {
    const std::string needle = std::string("\"") + key + '"';
    const int key_pos = strings::index_of(json, needle);
    const int colon = key_pos < 0 ? -1 : strings::index_of(json, ':', key_pos + needle.length());
    const int opening_quote = colon < 0 ? -1 : strings::index_of(json, '"', colon + 1);
    const int closing_quote =
        opening_quote < 0 ? -1 : strings::index_of(json, '"', opening_quote + 1);
    if (opening_quote < 0 || closing_quote <= opening_quote + 1) return {};
    return strings::slice(json, opening_quote + 1, closing_quote);
}

bool json_bool_value(const std::string& json, const char* key, bool& value) {
    const std::string needle = std::string("\"") + key + '"';
    const int key_pos = strings::index_of(json, needle);
    const int colon = key_pos < 0 ? -1 : strings::index_of(json, ':', key_pos + needle.length());
    if (colon < 0) return false;
    size_t value_pos = static_cast<size_t>(colon) + 1;
    while (value_pos < json.length() && isspace(static_cast<unsigned char>(json[value_pos]))) {
        ++value_pos;
    }
    if (json.compare(value_pos, 4, "true") == 0) {
        value = true;
        return true;
    }
    if (json.compare(value_pos, 5, "false") == 0) {
        value = false;
        return true;
    }
    return false;
}

/** Fetch a URL over TLS into `body`, refusing responses above `max_bytes`. */
bool fetch_text(const char* url, const char* user_agent, int timeout_ms, size_t max_bytes,
                std::string& body) {
    esp_http_client_config_t config = {};
    config.url = url;
    config.timeout_ms = timeout_ms;
    config.crt_bundle_attach = esp_crt_bundle_attach;
    config.user_agent = user_agent;
    config.disable_auto_redirect = false;
    config.max_redirection_count = 3;

    esp_http_client_handle_t client = esp_http_client_init(&config);
    if (!client) return false;

    bool success = false;
    esp_http_client_set_header(client, "Cache-Control", "no-cache");
    if (esp_http_client_open(client, 0) == ESP_OK) {
        const int64_t length = esp_http_client_fetch_headers(client);
        const int status = esp_http_client_get_status_code(client);
        if (status == 200 && length > 0 && static_cast<size_t>(length) <= max_bytes) {
            body.assign(static_cast<size_t>(length), '\0');
            const int read = esp_http_client_read_response(client, body.data(), length);
            if (read == length) {
                success = true;
            }
        }
        esp_http_client_close(client);
    }
    esp_http_client_cleanup(client);
    return success;
}
}  // namespace

DeviceWebServer device_web_server;

void DeviceWebServer::init(HardwareManager* hardware_manager, GrindController* grind_controller,
                           BluetoothManager* bluetooth_manager,
                           ProfileController* profile_controller) {
    if (initialized_) return;
    hardware_manager_ = hardware_manager;
    grind_controller_ = grind_controller;
    bluetooth_manager_ = bluetooth_manager;
    profile_controller_ = profile_controller;
    initialized_ = true;
}

void DeviceWebServer::begin() {
    if (!initialized_ || started_) return;
    // The listener socket needs lwIP, which only exists once the Wi-Fi driver is
    // running in station or access-point mode.
    if (!network_manager.is_radio_started()) return;

    httpd_config_t config = HTTPD_DEFAULT_CONFIG();
    config.server_port = 80;
    config.max_uri_handlers = 48;
    config.max_open_sockets = 7;
    config.lru_purge_enable = true;
    config.stack_size = 8192;
    config.recv_wait_timeout = 10;
    config.send_wait_timeout = 10;

    const esp_err_t err = httpd_start(&server_, &config);
    if (err != ESP_OK) {
        LOG_BLE("[WEB] HTTP service failed to start: %s\n", esp_err_to_name(err));
        server_ = nullptr;
        return;
    }

    // Routes can only be registered against a running server, so all three
    // route owners are attached here in one place.
    configure_routes();
    device_api.attach_routes(server_, hardware_manager_, grind_controller_, profile_controller_);
    provisioning_service.attach_routes(server_);

    started_ = true;
    LOG_BLE("[WEB] HTTP service listening on port 80\n");
}

void DeviceWebServer::update() {
    device_api.update();
    OtaPreparationState preparation = ota_preparation_state_.load();
    if (preparation == OtaPreparationState::REQUESTED) {
        const bool unsafe = ota_active_.load() || !grind_controller_ ||
                            grind_controller_->is_active() ||
                            (bluetooth_manager_ && bluetooth_manager_->is_transfer_active());
        if (unsafe) {
            recover_from_ota_failure();
        } else {
            if (bluetooth_manager_ && bluetooth_manager_->is_enabled()) {
                LOG_BLE("[WEB OTA] Temporarily disabling Bluetooth to free update memory\n");
                bluetooth_manager_->disable();
                ota_bluetooth_stopped_.store(true);
            }
            if (heap_caps_get_free_size(MALLOC_CAP_INTERNAL | MALLOC_CAP_8BIT) >=
                OTA_MIN_INTERNAL_HEAP) {
                ota_preparation_deadline_ms_.store(millis() + OTA_READY_WINDOW_MS);
                ota_preparation_state_.store(OtaPreparationState::READY);
                LOG_BLE("[WEB OTA] Update preparation complete\n");
            } else if (static_cast<int32_t>(millis() - ota_preparation_deadline_ms_.load()) >= 0) {
                LOG_BLE("[WEB OTA] Could not recover enough internal memory\n");
                recover_from_ota_failure();
            }
        }
    } else if (preparation == OtaPreparationState::READY && !ota_active_.load() &&
               static_cast<int32_t>(millis() - ota_preparation_deadline_ms_.load()) >= 0) {
        LOG_BLE("[WEB OTA] Prepared upload expired\n");
        recover_from_ota_failure();
    }

    if (on_device_update_pending_.load() && is_ota_ready()) {
        const std::string tag = latest_release_tag();
        on_device_update_pending_.store(false);
        if (tag.empty() || !start_github_ota(tag)) {
            LOG_BLE("[WEB OTA] Could not start requested on-device update\n");
            recover_from_ota_failure();
        }
    }

    const uint32_t now = millis();
    const uint32_t interval = firmware_update_state_.load() == FirmwareUpdateState::FAILED
                                  ? UPDATE_CHECK_RETRY_MS
                                  : UPDATE_CHECK_INTERVAL_MS;
    const uint32_t last_check = last_firmware_update_check_ms_.load();
    const bool check_due = last_check == 0 || now - last_check >= interval;
    const bool check_safe = network_manager.is_connected() && !ota_active_.load() &&
                            ota_preparation_state_.load() == OtaPreparationState::IDLE &&
                            (!grind_controller_ || !grind_controller_->is_active()) &&
                            (!bluetooth_manager_ || !bluetooth_manager_->is_transfer_active()) &&
                            heap_caps_get_free_size(MALLOC_CAP_INTERNAL | MALLOC_CAP_8BIT) >=
                                OTA_MIN_INTERNAL_HEAP;
    if (check_due && check_safe) {
        bool expected_inactive = false;
        if (firmware_update_check_active_.compare_exchange_strong(expected_inactive, true)) {
            firmware_update_state_.store(FirmwareUpdateState::CHECKING);
            if (xTaskCreate(firmware_update_check_task, "update_check", UPDATE_CHECK_TASK_STACK,
                            nullptr, 1, nullptr) != pdPASS) {
                firmware_update_check_active_.store(false);
                firmware_update_state_.store(FirmwareUpdateState::FAILED);
                last_firmware_update_check_ms_.store(now);
            }
        }
    }
    if (reboot_pending_.load() &&
        static_cast<int32_t>(millis() - reboot_at_ms_.load()) >= 0) {
        LOG_BLE("[WEB OTA] Restarting device\n");
        fflush(stdout);
        esp_restart();
    }
}

std::string DeviceWebServer::latest_release_tag() const {
    if (latest_version_major_.load() == 0 && latest_version_minor_.load() == 0 &&
        latest_version_patch_.load() == 0) {
        return {};
    }
    char tag[25];
    snprintf(tag, sizeof(tag), "v%u.%u.%u", latest_version_major_.load(),
             latest_version_minor_.load(), latest_version_patch_.load());
    return tag;
}

bool DeviceWebServer::install_available_update() {
    if (!firmware_update_available() || latest_release_tag().empty() ||
        !network_manager.is_connected() || ota_active_.load() ||
        ota_preparation_state_.load() != OtaPreparationState::IDLE ||
        (grind_controller_ && grind_controller_->is_active()) ||
        (bluetooth_manager_ && bluetooth_manager_->is_transfer_active())) {
        return false;
    }
    on_device_update_pending_.store(true);
    request_ota_preparation();
    return true;
}

void DeviceWebServer::firmware_update_check_task(void*) {
    device_web_server.perform_firmware_update_check();
    device_web_server.firmware_update_check_active_.store(false);
    vTaskDelete(nullptr);
}

void DeviceWebServer::perform_firmware_update_check() {
    FirmwareUpdateState result = FirmwareUpdateState::FAILED;

    std::string manifest;
    if (fetch_text(LATEST_RELEASE_MANIFEST_URL, "SmartGrind-UpdateCheck/1", 10000, 512,
                   manifest)) {
        const std::string tag = json_string_value(manifest, "tag");
        bool v1_available = false;
        bool v2_available = false;
        uint16_t major = 0;
        uint16_t minor = 0;
        uint16_t patch = 0;
        if (valid_release_tag(tag) && parse_semver(tag, major, minor, patch) &&
            json_bool_value(manifest, "v1", v1_available) &&
            json_bool_value(manifest, "v2", v2_available)) {
            const bool asset_available = HW_DISPLAY_VARIANT_V2 ? v2_available : v1_available;
            uint16_t current_major = 0;
            uint16_t current_minor = 0;
            uint16_t current_patch = 0;
            if (asset_available &&
                parse_semver(BUILD_FIRMWARE_VERSION, current_major, current_minor,
                             current_patch)) {
                latest_version_major_.store(major);
                latest_version_minor_.store(minor);
                latest_version_patch_.store(patch);
                const bool newer = major > current_major ||
                                   (major == current_major && minor > current_minor) ||
                                   (major == current_major && minor == current_minor &&
                                    patch > current_patch);
                result = newer ? FirmwareUpdateState::AVAILABLE : FirmwareUpdateState::CURRENT;
            }
        }
    }

    last_firmware_update_check_ms_.store(millis());
    firmware_update_state_.store(result);
    const std::string latest_tag = latest_release_tag();
    LOG_BLE("[WEB OTA] Firmware update check: %s%s%s\n",
            result == FirmwareUpdateState::AVAILABLE ? "available" :
            result == FirmwareUpdateState::CURRENT ? "current" : "failed",
            latest_tag.empty() ? "" : " ", latest_tag.c_str());
}

bool DeviceWebServer::is_ota_ready() const {
    return ota_preparation_state_.load() == OtaPreparationState::READY &&
           initialized_ && network_manager.is_connected() && !ota_active_.load() &&
           (!grind_controller_ || !grind_controller_->is_active()) &&
           (!bluetooth_manager_ || !bluetooth_manager_->is_transfer_active()) &&
           heap_caps_get_free_size(MALLOC_CAP_INTERNAL | MALLOC_CAP_8BIT) >= OTA_MIN_INTERNAL_HEAP;
}

void DeviceWebServer::request_ota_preparation() {
    ota_bluetooth_stopped_.store(false);
    ota_preparation_deadline_ms_.store(millis() + OTA_PREPARE_TIMEOUT_MS);
    ota_preparation_state_.store(OtaPreparationState::REQUESTED);
}

void DeviceWebServer::recover_from_ota_failure() {
    ota_preparation_state_.store(OtaPreparationState::IDLE);
    if (ota_bluetooth_stopped_.exchange(false)) {
        // Re-enabling the BLE stack in the same boot duplicates services and
        // leaks heap, so recover through a clean reboot into the still-valid
        // running firmware instead.
        LOG_BLE("[WEB OTA] Scheduling clean recovery restart\n");
        reboot_at_ms_.store(millis() + OTA_REBOOT_DELAY_MS);
        reboot_pending_.store(true);
    }
}

uint8_t DeviceWebServer::ota_progress_percent() const {
    const size_t total = ota_total_.load();
    if (!ota_active_.load() || total == 0) return 0;
    const size_t percent = (ota_received_.load() * 100U) / total;
    return static_cast<uint8_t>(percent > 100 ? 100 : percent);
}

void DeviceWebServer::configure_routes() {
    http::route(server_, "/api/v1/status", HTTP_GET, [](httpd_req_t* request) {
        char body[1024];
        const std::string hostname = http::json_escape(network_manager.hostname());
        const std::string device_id = http::json_escape(network_manager.device_id());
        const std::string network_name = http::json_escape(network_manager.network_name());
        const std::string ip_address = http::json_escape(network_manager.ip_address());
        snprintf(
            body, sizeof(body),
            "{\"api\":\"v1\",\"device\":{\"id\":\"%s\",\"model\":\"ESP32-S3-Touch-AMOLED-1.64\",\"hardware_revision\":\"%s\"},"
            "\"capabilities\":{\"protocol\":1,\"transport\":\"websocket\",\"path\":\"/ws\",\"state_interval_ms\":100,"
            "\"commands\":[\"start\",\"start_manual\",\"stop\",\"dismiss\",\"tare\",\"select_profile\",\"set_mode\"]},"
            "\"firmware\":{\"version\":\"%s\",\"build\":%d,\"commit\":\"%s\"},"
            "\"network\":{\"state\":\"%s\",\"hostname\":\"%s\",\"ssid\":\"%s\",\"ip\":\"%s\"},"
            "\"system\":{\"uptime_ms\":%lu,\"free_heap\":%u,\"free_internal_heap\":%u,"
            "\"largest_internal_block\":%u,\"free_psram\":%u},"
            "\"ota\":{\"active\":%s,\"preparing\":%s,\"ready\":%s,\"progress\":%u}}",
            device_id.c_str(),
            HW_DISPLAY_REVISION,
            BUILD_FIRMWARE_VERSION,
            BUILD_NUMBER,
            GIT_COMMIT_ID,
            network_state_name(network_manager.state()),
            hostname.c_str(),
            network_name.c_str(),
            ip_address.c_str(),
            static_cast<unsigned long>(millis()),
            static_cast<unsigned int>(device_info::free_heap_bytes()),
            static_cast<unsigned int>(device_info::free_internal_heap_bytes()),
            static_cast<unsigned int>(device_info::largest_free_internal_block_bytes()),
            static_cast<unsigned int>(device_info::free_psram_bytes()),
            device_web_server.is_ota_active() ? "true" : "false",
            device_web_server.is_ota_preparing() ? "true" : "false",
            device_web_server.is_ota_ready() ? "true" : "false",
            device_web_server.ota_progress_percent());
        return http::send_json(request, 200, body);
    });

    http::route(server_, "/health", HTTP_GET, [](httpd_req_t* request) {
        return http::send(request, 200, "text/plain", "ok");
    });

    http::route(server_, "/api/v1/logs", HTTP_GET, [](httpd_req_t* request) {
        httpd_resp_set_hdr(request, "Cache-Control", "private, no-store");
        return http::send(request, 200, "text/plain; charset=utf-8", diagnostic_log_snapshot());
    });

    http::route(server_, "/api/v1/history", HTTP_GET, [this](httpd_req_t* request) {
        if (history_is_busy(grind_controller_) || ota_active_.load() ||
            (bluetooth_manager_ && bluetooth_manager_->is_transfer_active())) {
            return http::send_error(request, 409,
                                    "History is busy; try again when the grinder is idle");
        }

        std::vector<uint32_t> session_ids;
        FsFile directory = filesystem.open(GRIND_SESSIONS_DIR);
        if (directory && directory.isDirectory()) {
            FsFile entry = directory.openNextFile();
            while (entry) {
                const std::string name = entry.name();
                const int marker = strings::last_index_of(name, "session_");
                const int suffix = strings::last_index_of(name, ".bin");
                if (!entry.isDirectory() && marker >= 0 && suffix > marker + 8) {
                    const uint32_t id =
                        strings::to_uint32(strings::slice(name, marker + 8, suffix));
                    if (id > 0) session_ids.push_back(id);
                }
                entry = directory.openNextFile();
            }
        }
        std::sort(session_ids.begin(), session_ids.end(), std::greater<uint32_t>());
        if (session_ids.size() > MAX_STORED_SESSIONS_FLASH) {
            session_ids.resize(MAX_STORED_SESSIONS_FLASH);
        }

        // Chunked: the session list can exceed what fits in one response buffer.
        httpd_resp_set_type(request, "application/json");
        httpd_resp_set_hdr(request, "Cache-Control", "no-store");
        char chunk[512];
        snprintf(chunk, sizeof(chunk), "{\"api\":\"v1\",\"storage_version\":%lu,\"sessions\":[",
                 static_cast<unsigned long>(grind_logger.get_session_storage_version()));
        httpd_resp_send_chunk(request, chunk, HTTPD_RESP_USE_STRLEN);

        bool first = true;
        for (uint32_t id : session_ids) {
            if (!grind_logger.validate_stored_session(id)) continue;
            char path[48];
            snprintf(path, sizeof(path), SESSION_FILE_FORMAT, static_cast<unsigned long>(id));
            FsFile file = filesystem.open(path, "r");
            TimeSeriesSessionHeader header{};
            GrindSession session{};
            if (!file ||
                file.read(reinterpret_cast<uint8_t*>(&header), sizeof(header)) != sizeof(header) ||
                file.read(reinterpret_cast<uint8_t*>(&session), sizeof(session)) !=
                    sizeof(session) ||
                header.session_id != id || session.session_id != id) {
                continue;
            }
            char result[sizeof(session.result_status) + 1]{};
            memcpy(result, session.result_status, sizeof(session.result_status));
            snprintf(
                chunk, sizeof(chunk),
                "%s{\"id\":%lu,\"timestamp\":%lu,\"profile\":%u,\"mode\":\"%s\","
                "\"target_weight\":%.2f,\"target_time_ms\":%lu,\"final_weight\":%.2f,"
                "\"error_grams\":%.2f,\"time_error_ms\":%ld,\"duration_ms\":%lu,"
                "\"motor_time_ms\":%lu,\"pulses\":%u,\"result\":\"%s\","
                "\"events\":%u,\"measurements\":%u,\"schema\":%u}",
                first ? "" : ",",
                static_cast<unsigned long>(id), static_cast<unsigned long>(session.session_timestamp),
                session.profile_id, session.grind_mode == 1 ? "time" : "weight",
                session.target_weight, static_cast<unsigned long>(session.target_time_ms),
                session.final_weight, session.error_grams, static_cast<long>(session.time_error_ms),
                static_cast<unsigned long>(session.total_time_ms),
                static_cast<unsigned long>(session.total_motor_on_time_ms), session.pulse_count,
                http::json_escape(result).c_str(), header.event_count, header.measurement_count,
                header.schema_version);
            first = false;
            httpd_resp_send_chunk(request, chunk, HTTPD_RESP_USE_STRLEN);
        }
        httpd_resp_send_chunk(request, "]}", HTTPD_RESP_USE_STRLEN);
        return httpd_resp_send_chunk(request, nullptr, 0);
    });

    http::route(server_, "/api/v1/history/session", HTTP_GET, [this](httpd_req_t* request) {
        std::string text_id;
        if (!http::query_param(request, "id", text_id)) {
            return http::send_error(request, 400, "Session id is required");
        }
        if (history_is_busy(grind_controller_) || ota_active_.load() ||
            (bluetooth_manager_ && bluetooth_manager_->is_transfer_active())) {
            return http::send_error(request, 409,
                                    "History is busy; try again when the grinder is idle");
        }
        for (const char digit : text_id) {
            if (!isdigit(static_cast<unsigned char>(digit))) {
                return http::send_error(request, 400, "Invalid session id");
            }
        }
        const uint32_t id = strings::to_uint32(text_id);
        if (id == 0) return http::send_error(request, 400, "Invalid session id");

        char path[48];
        snprintf(path, sizeof(path), SESSION_FILE_FORMAT, static_cast<unsigned long>(id));
        if (!filesystem.exists(path) || !grind_logger.validate_stored_session(id)) {
            return http::send_error(request, 404, "Session not found");
        }
        return http::send_file(request, path, "application/vnd.smartgrind.session",
                               http::has_query_param(request, "download"));
    });

    http::route(server_, "/api/v1/screensaver/image", HTTP_POST, [this](httpd_req_t* request) {
        return handle_screensaver_upload(request);
    });

    http::route(server_, "/api/v1/screensaver/image", HTTP_GET, [this](httpd_req_t* request) {
        if ((grind_controller_ && grind_controller_->is_active()) || ota_active_.load() ||
            (bluetooth_manager_ && bluetooth_manager_->is_transfer_active())) {
            return http::send_error(request, 409, "Screensaver image is busy");
        }
        if (!filesystem.exists(BLE_IMAGE_FILENAME)) {
            return http::send_error(request, 404, "No custom screensaver is stored");
        }
        return http::send_file(request, BLE_IMAGE_FILENAME,
                               "application/vnd.smartgrind.rgb565", false);
    });

    http::route(server_, "/api/v1/screensaver/image", HTTP_DELETE, [this](httpd_req_t* request) {
        if (!http::origin_allowed(request)) {
            return http::send_error(request, 403, "Request origin is not allowed");
        }
        if (!bluetooth_manager_ || ota_active_.load() ||
            (grind_controller_ && grind_controller_->is_active()) ||
            bluetooth_manager_->is_transfer_active()) {
            return http::send_error(request, 409, "Screensaver image is busy");
        }
        const bool deleted = bluetooth_manager_->delete_screensaver_image();
        if (deleted) device_api.mark_settings_dirty();
        return deleted ? http::send_json(request, 200, "{\"deleted\":true}")
                       : http::send_error(request, 500, "Could not delete screensaver");
    });

    http::route(server_, "/api/v1/ota/prepare", HTTP_POST, [this](httpd_req_t* request) {
        if (ota_active_.load()) {
            return http::send_error(request, 409, "A firmware update is already active");
        }
        const OtaPreparationState preparation = ota_preparation_state_.load();
        if (preparation == OtaPreparationState::READY) {
            return http::send_json(request, 200, "{\"ready\":true}");
        }
        if (preparation == OtaPreparationState::REQUESTED) {
            return http::send_json(request, 202, "{\"preparing\":true}");
        }
        if (firmware_update_check_active_.load()) {
            return http::send_error(request, 409,
                                    "Wait for the firmware update check to finish");
        }
        if (!grind_controller_ || grind_controller_->is_active()) {
            return http::send_error(request, 409, "Stop the grinder before updating firmware");
        }
        if (bluetooth_manager_ && bluetooth_manager_->is_transfer_active()) {
            return http::send_error(request, 409, "Wait for the Bluetooth transfer to finish");
        }
        request_ota_preparation();
        return http::send_json(request, 202, "{\"preparing\":true}");
    });

    http::route(server_, "/api/v1/ota/github", HTTP_POST, [this](httpd_req_t* request) {
        if (!http::origin_allowed(request)) {
            return http::send_error(request, 403, "Request origin is not allowed");
        }
        std::string form;
        std::string tag;
        if (!http::read_body(request, form, 256) || !http::form_field(form, "tag", tag)) {
            return http::send_error(request, 400, "Release tag is required");
        }
        if (!valid_release_tag(tag)) {
            return http::send_error(request, 400, "Release tag is invalid");
        }
        if (!start_github_ota(tag)) {
            return http::send_error(request, 409, "Prepare the update before installing");
        }
        return http::send_json(request, 202, "{\"accepted\":true}");
    });

    http::route(server_, "/api/v1/ota", HTTP_POST, [this](httpd_req_t* request) {
        return handle_ota_upload(request);
    });
}

bool DeviceWebServer::start_github_ota(const std::string& tag) {
    if (!is_ota_ready()) return false;
    bool expected_inactive = false;
    if (!ota_active_.compare_exchange_strong(expected_inactive, true)) return false;
    ota_preparation_state_.store(OtaPreparationState::IDLE);
    ota_received_.store(0);
    ota_total_.store(0);

    auto* task_tag = new (std::nothrow) std::string(tag);
    if (!task_tag || xTaskCreate(github_ota_task, "github_ota", OTA_DOWNLOAD_TASK_STACK,
                                 task_tag, 1, nullptr) != pdPASS) {
        delete task_tag;
        finish_ota(false);
        return false;
    }
    return true;
}

void DeviceWebServer::github_ota_task(void* parameter) {
    std::unique_ptr<std::string> task_tag(static_cast<std::string*>(parameter));
    device_web_server.perform_github_ota(task_tag ? *task_tag : std::string());
    vTaskDelete(nullptr);
}

void DeviceWebServer::perform_github_ota(const std::string& tag) {
    const std::string filename =
        "smart-grind-by-weight-" + tag + HW_RELEASE_FIRMWARE_SUFFIX + ".bin";
    const std::string url = std::string(GITHUB_RELEASE_MIRROR_BASE) + tag + "/" + filename;
    LOG_BLE("[WEB OTA] Downloading %s from release mirror\n", filename.c_str());
    if (hardware_manager_ && hardware_manager_->get_grinder()) {
        hardware_manager_->get_grinder()->stop();
    }

    esp_http_client_config_t config = {};
    config.url = url.c_str();
    config.timeout_ms = 15000;
    config.crt_bundle_attach = esp_crt_bundle_attach;
    config.user_agent = "SmartGrind-OTA/1";
    config.disable_auto_redirect = false;
    config.max_redirection_count = 3;
    config.buffer_size = 1024;

    esp_http_client_handle_t client = esp_http_client_init(&config);
    if (!client) {
        LOG_BLE("[WEB OTA] Could not initialise release-mirror connection\n");
        finish_ota(false);
        return;
    }

    esp_http_client_set_header(client, "Cache-Control", "no-cache");
    if (esp_http_client_open(client, 0) != ESP_OK) {
        LOG_BLE("[WEB OTA] Could not open release-mirror connection\n");
        esp_http_client_cleanup(client);
        finish_ota(false);
        return;
    }

    const int64_t content_length = esp_http_client_fetch_headers(client);
    const int status = esp_http_client_get_status_code(client);
    if (status != 200) {
        LOG_BLE("[WEB OTA] Release download failed: HTTP %d, epoch %lld, heap %u, largest %u\n",
                status, static_cast<long long>(time(nullptr)),
                static_cast<unsigned int>(device_info::free_internal_heap_bytes()),
                static_cast<unsigned int>(device_info::largest_free_internal_block_bytes()));
        esp_http_client_close(client);
        esp_http_client_cleanup(client);
        finish_ota(false);
        return;
    }

    const esp_partition_t* target = esp_ota_get_next_update_partition(nullptr);
    if (!target || content_length <= 0 || static_cast<size_t>(content_length) > target->size) {
        LOG_BLE("[WEB OTA] Invalid image size: %lld\n", static_cast<long long>(content_length));
        esp_http_client_close(client);
        esp_http_client_cleanup(client);
        finish_ota(false);
        return;
    }

    std::vector<uint8_t> buffer(OTA_DOWNLOAD_BUFFER);
    bool started = false;
    bool failed = false;
    ota_total_.store(static_cast<size_t>(content_length));
    ota_received_.store(0);

    uint32_t idle_deadline = millis() + OTA_IDLE_TIMEOUT_MS;
    while (ota_received_.load() < ota_total_.load()) {
        const int read = esp_http_client_read(client, reinterpret_cast<char*>(buffer.data()),
                                             buffer.size());
        if (read < 0) {
            failed = true;
            break;
        }
        if (read == 0) {
            if (static_cast<int32_t>(millis() - idle_deadline) >= 0) break;
            vTaskDelay(pdMS_TO_TICKS(2));
            continue;
        }
        if (!started) {
            // An ESP32 application image always begins with the 0xE9 magic byte.
            if (buffer[0] != 0xE9) {
                LOG_BLE("[WEB OTA] Download is not an ESP32 application image\n");
                failed = true;
                break;
            }
            if (!web_firmware_update.begin(static_cast<size_t>(content_length))) {
                LOG_BLE("[WEB OTA] Could not open inactive partition: %s\n",
                        web_firmware_update.error());
                failed = true;
                break;
            }
            started = true;
        }
        if (!web_firmware_update.write(buffer.data(), static_cast<size_t>(read))) {
            LOG_BLE("[WEB OTA] Flash write failed: %s\n", web_firmware_update.error());
            failed = true;
            break;
        }
        ota_received_.fetch_add(static_cast<size_t>(read));
        idle_deadline = millis() + OTA_IDLE_TIMEOUT_MS;
    }

    esp_http_client_close(client);
    esp_http_client_cleanup(client);

    const bool complete = !failed && ota_received_.load() == ota_total_.load();
    const bool valid = complete && started && web_firmware_update.end();
    if (!valid) {
        web_firmware_update.abort();
        LOG_BLE("[WEB OTA] Download incomplete or invalid (%lu/%lu): %s\n",
                static_cast<unsigned long>(ota_received_.load()),
                static_cast<unsigned long>(ota_total_.load()), web_firmware_update.error());
        finish_ota(false);
        return;
    }
    LOG_BLE("[WEB OTA] GitHub firmware validated (%lu bytes)\n",
            static_cast<unsigned long>(ota_received_.load()));
    finish_ota(true);
}

esp_err_t DeviceWebServer::handle_ota_upload(httpd_req_t* request) {
    if (!is_ota_ready()) {
        return http::send(request, 409, "text/plain",
                          "Prepare the firmware update before uploading");
    }
    bool expected_inactive = false;
    if (!ota_active_.compare_exchange_strong(expected_inactive, true)) {
        return http::send(request, 409, "text/plain",
                          "Another firmware update is already active");
    }
    ota_preparation_state_.store(OtaPreparationState::IDLE);

    if (!grind_controller_ || grind_controller_->is_active()) {
        finish_ota(false);
        return http::send(request, 409, "text/plain", "Stop the grinder before updating firmware");
    }
    if (bluetooth_manager_ && bluetooth_manager_->is_transfer_active()) {
        finish_ota(false);
        return http::send(request, 409, "text/plain", "Wait for the Bluetooth transfer to finish");
    }
    if (device_info::free_internal_heap_bytes() < OTA_MIN_INTERNAL_HEAP) {
        finish_ota(false);
        return http::send(request, 503, "text/plain",
                          "Prepare the update first so Bluetooth can release memory");
    }
    const esp_partition_t* target = esp_ota_get_next_update_partition(nullptr);
    if (!target || request->content_len > target->size + 8192U) {
        finish_ota(false);
        return http::send(request, 413, "text/plain", "Firmware image is too large");
    }

    MultipartReader reader;
    if (!reader.begin(http::header(request, "Content-Type"))) {
        finish_ota(false);
        return http::send(request, 400, "text/plain",
                          "Expected a multipart/form-data firmware upload");
    }

    if (hardware_manager_ && hardware_manager_->get_grinder()) {
        hardware_manager_->get_grinder()->stop();
    }

    ota_received_.store(0);
    ota_total_.store(request->content_len);

    bool started = false;
    bool rejected_magic = false;
    const auto sink = [this, &started, &rejected_magic](const uint8_t* data, size_t length) {
        if (!started) {
            // An ESP32 application image always begins with the 0xE9 magic byte.
            if (length == 0 || data[0] != 0xE9) {
                rejected_magic = true;
                return false;
            }
            if (!web_firmware_update.begin(0)) return false;
            started = true;
        }
        if (!web_firmware_update.write(data, length)) return false;
        ota_received_.fetch_add(length);
        return true;
    };

    std::vector<uint8_t> chunk(2048);
    size_t remaining = request->content_len;
    bool stream_ok = true;
    while (remaining > 0 && stream_ok) {
        const int received =
            httpd_req_recv(request, reinterpret_cast<char*>(chunk.data()),
                           remaining < chunk.size() ? remaining : chunk.size());
        if (received == HTTPD_SOCK_ERR_TIMEOUT) continue;
        if (received <= 0) {
            stream_ok = false;
            break;
        }
        remaining -= static_cast<size_t>(received);
        stream_ok = reader.feed(chunk.data(), static_cast<size_t>(received), sink);
    }

    if (!stream_ok || !reader.saw_file()) {
        web_firmware_update.abort();
        const char* message = rejected_magic ? "Not a valid ESP32 firmware image"
                              : !reader.saw_file() ? "Firmware file was not received"
                                                   : "Firmware update failed";
        const int status = rejected_magic ? 400 : (!reader.saw_file() ? 400 : 500);
        LOG_BLE("[WEB OTA] Upload aborted at %lu bytes: %s\n",
                static_cast<unsigned long>(ota_received_.load()), message);
        finish_ota(false);
        return http::send(request, status, "text/plain", message);
    }

    if (!web_firmware_update.end()) {
        LOG_BLE("[WEB OTA] Image validation failed: %s\n", web_firmware_update.error());
        finish_ota(false);
        return http::send(request, 500, "text/plain", "Firmware update failed");
    }

    LOG_BLE("[WEB OTA] Firmware validated (%lu bytes)\n",
            static_cast<unsigned long>(ota_received_.load()));
    finish_ota(true);
    return http::send(request, 200, "text/plain",
                      "Firmware accepted; Smart Grind is restarting");
}

esp_err_t DeviceWebServer::handle_screensaver_upload(httpd_req_t* request) {
    if (!http::origin_allowed(request)) {
        return http::send_error(request, 403, "Request origin is not allowed");
    }
    if (!bluetooth_manager_ || ota_active_.load() ||
        (grind_controller_ && grind_controller_->is_active()) ||
        bluetooth_manager_->is_transfer_active()) {
        return http::send_error(request, 409,
                                "Stop the grinder and other transfers before uploading");
    }

    MultipartReader reader;
    if (!reader.begin(http::header(request, "Content-Type"))) {
        return http::send_error(request, 400, "Expected a multipart/form-data image upload");
    }
    if (!bluetooth_manager_->begin_screensaver_image_upload(BLE_IMAGE_EXPECTED_SIZE)) {
        return http::send_error(request, 400, "Image must be a 280 x 456 RGB565 frame");
    }

    const auto sink = [this](const uint8_t* data, size_t length) {
        return bluetooth_manager_->write_screensaver_image_chunk(data, length);
    };

    std::vector<uint8_t> chunk(2048);
    size_t remaining = request->content_len;
    bool stream_ok = true;
    while (remaining > 0 && stream_ok) {
        const int received =
            httpd_req_recv(request, reinterpret_cast<char*>(chunk.data()),
                           remaining < chunk.size() ? remaining : chunk.size());
        if (received == HTTPD_SOCK_ERR_TIMEOUT) continue;
        if (received <= 0) {
            stream_ok = false;
            break;
        }
        remaining -= static_cast<size_t>(received);
        stream_ok = reader.feed(chunk.data(), static_cast<size_t>(received), sink);
    }

    if (!stream_ok || !reader.saw_file()) {
        bluetooth_manager_->abort_screensaver_image_upload();
        return http::send_error(request, stream_ok ? 400 : 500,
                                stream_ok ? "Screensaver image was not received"
                                          : "Could not store image data");
    }

    if (!bluetooth_manager_->finish_screensaver_image_upload()) {
        return http::send_error(request, 500, "Screensaver upload failed");
    }
    device_api.mark_settings_dirty();
    return http::send_json(request, 200, "{\"saved\":true}");
}

void DeviceWebServer::finish_ota(bool success) {
    ota_active_.store(false);
    if (success) {
        ota_bluetooth_stopped_.store(false);
        ota_preparation_state_.store(OtaPreparationState::IDLE);
        reboot_at_ms_.store(millis() + OTA_REBOOT_DELAY_MS);
        reboot_pending_.store(true);
    } else {
        recover_from_ota_failure();
    }
}
